/*
 * Copyright (c) 2020 ZMK Contributors
 *
 * SPDX-License-Identifier: MIT
 */
 
#include "dilemma.dtsi"


&default_transform {
   col-offset = <4>;
map = <
    RC(0,5) RC(0,6) RC(0,7) RC(0,8) RC(0,9)
    RC(1,5) RC(1,6) RC(1,7) RC(1,8) RC(1,9)
    RC(2,5) RC(2,6) RC(2,7) RC(2,8) RC(2,9)
                            RC(3,7) RC(3,9)
>;
};

&kscan0 {
	col-gpios
		= <&pro_micro 8  (GPIO_ACTIVE_HIGH | GPIO_PULL_DOWN)>
		, <&pro_micro 9  (GPIO_ACTIVE_HIGH | GPIO_PULL_DOWN)>
		, <&pro_micro 7  (GPIO_ACTIVE_HIGH | GPIO_PULL_DOWN)>
		, <&pro_micro 6  (GPIO_ACTIVE_HIGH | GPIO_PULL_DOWN)>
		, <&pro_micro 19 (GPIO_ACTIVE_HIGH | GPIO_PULL_DOWN)>
		;
};
