#include "ergovision.dtsi"
#include <dt-bindings/zmk/matrix_transform.h>
#include <zephyr/dt-bindings/input/input-event-codes.h>
#include <dt-bindings/zmk/pointing.h>
#include <input/processors.dtsi>
&default_transform {
        col-offset = <6>; // Offset for the right-hand side columns
};

&pro_micro_i2c {
    status = "okay"; // Enable I2C1 for the Nice Nano V2
      glidepoint: glidepoint@1 {
         compatible = "cirque,pinnacle";
         reg = <1>;
         status = "okay";
         sensitivity = "4x"; // Set sensitivity
         no-taps;            // Disable tap gestures
         sleep;              // Enable sleep mode for power saving
     };
};

&glidepoint_split {
    device = <&right_glidepoint_split>; // Assign the right-hand GlidePoint trackpad to split
    input-processors = <&zip_xy_transform (INPUT_TRANSFORM_XY_SWAP | INPUT_TRANSFORM_X_INVERT | INPUT_TRANSFORM_Y_INVERT)>;
};

