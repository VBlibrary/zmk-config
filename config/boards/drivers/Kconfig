## config/boards/drivers/Kconfig
```kconfig
# Copyright (c) 2020 The ZMK Contributors
# SPDX-License-Identifier: MIT


rsource "cirque_trackpad/Kconfig"
```

## config/boards/shields/ergovision/Kconfig.defconfig
```kconfig
# Copyright (c) 2022 ZMK Contributors
# SPDX-License-Identifier: MIT

if SHIELD_ERGOVISION_LEFT

config ZMK_KEYBOARD_NAME
    default "ergovision_left"

endif

if SHIELD_ERGOVISION_RIGHT

config ZMK_KEYBOARD_NAME
    default "ErgoVision"

config ZMK_SPLIT_BLE_ROLE_CENTRAL
    default y

endif

if SHIELD_ERGOVISION_LEFT || SHIELD_ERGOVISION_RIGHT

# Enable split keyboard functionality
config ZMK_SPLIT
    default y

# Enable USB functionality
config ZMK_USB
    default y

# Enable I2C communication
config I2C 
    default y

# Enable USB HID support
config ZMK_USB_HID
    bool "Enable USB HID support"  # Add type and prompt for clarity
    default y

# Enable USB device stack (needed for USB communication)
config USB_DEVICE_STACK
    bool "Enable USB device stack"  # Add type and prompt for clarity
    default y

# Enable USB HID subsystem
config USB_HID
    bool "Enable USB HID"  # Add type and prompt for clarity
    default y

# Enable HID reports (necessary for keyboard input)
config ZMK_HID_REPORTS
    bool "Enable HID reports"  # Add type and prompt for clarity
    default y

# Enable serial communication (if using UART for console or logging)
config SERIAL
    bool "Enable Serial"  # Add type and prompt for clarity
    default y

# Enable UART console (optional, only if needed for logging/debugging)
config UART_CONSOLE
    bool "Enable UART Console"  # Add type and prompt for clarity
    default y

# Enable the driver for serial communication
config SERIAL_HAS_DRIVER
    bool "Enable Serial Driver"  # Add type and prompt for clarity
    default y

# Optional: Disable USB logging if not needed
config ZMK_USB_LOGGING
    bool "Enable USB Logging"  # Add type and prompt for clarity
    default n

endif
```

## config/boards/shields/gamepad/Kconfig.defconfig
```kconfig
# Copyright (c) 2022 ZMK Contributors
# SPDX-License-Identifier: MIT

if SHIELD_GAMEPAD

config ZMK_KEYBOARD_NAME
    default "Gamepad"

config ZMK_USB
	default y
endif
```

## config/boards/shields/gamepad/Kconfig.shield
```kconfig
# Copyright (c) 2020 ZMK Contributors
# SPDX-License-Identifier: MIT

config SHIELD_GAMEPAD
	def_bool $(shields_list_contains,gamepad)
```

## config/west.yml
```yaml
manifest:
  remotes:
    - name: zmkfirmware
      url-base: https://github.com/zmkfirmware
  projects:
    - name: zmk
      remote: zmkfirmware
      revision: main
      import: app/west.yml
  self:
    path: config

build:
  # Ensure a clean build is forced
  clean: true
  config:
    # Add any other build options here
    debug: true
```
